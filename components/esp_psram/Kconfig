## components/esp_psram/Kconfig
```kconfig
menu "ESP PSRAM"
    depends on !APP_BUILD_TYPE_PURE_RAM_APP
    # Will be refactored after !18050 to merge target-specific items

    orsource "./$IDF_TARGET/Kconfig.spiram"

    config SPIRAM_TRY_ALLOCATE_WIFI_LWIP
        bool "Try to allocate memories of WiFi and LWIP in SPIRAM firstly. If failed, allocate internal memory"
        depends on SPIRAM
        default "n"
        help
            Try to allocate memories of WiFi and LWIP in SPIRAM firstly. If failed, try to allocate internal
            memory then.

endmenu  # ESP PSRAM
```
